## arch/riscv/cmd/Kconfig
```kconfig
menu "RISC-V specific commands"
	depends on RISCV

config CMD_ENDIAN
	bool "Endian switch command"
	help
	  Some RISC-V cpus can switch endianness on the fly. This command allows
	  the user to check the current endianness of the cpu. And switch
	  it if possible. This is experimental for the moment as some values
	  are hard-coded.

endmenu
```

## arch/riscv/cpu/p8700/Kconfig
```kconfig
# SPDX-License-Identifier: GPL-2.0+
#
# Copyright (C) 2021, Chao-ying Fu <cfu@mips.com>

config P8700_RISCV
	bool
	select ARCH_EARLY_INIT_R
	imply CPU
	imply CPU_RISCV
	imply RISCV_ACLINT if (RISCV_MMODE || SPL_RISCV_MMODE)
	imply CMD_CPU
	imply SPL_CPU_SUPPORT
	imply SPL_OPENSBI
	imply SPL_LOAD_FIT

config RISCV_CM_BASE
	hex "RISCV CM Base Address"
	default 0x16100000
	help
	  The physical base address at which to map the Coherence Manager
	  Global Configuration Registers (GCRs).
```

## board/mips/boston-riscv/Kconfig
```kconfig
if TARGET_MIPS_BOSTON

config SYS_BOARD
	default "boston-riscv"

config SYS_VENDOR
	default "mips"

config SYS_CONFIG_NAME
	default "boston-riscv"

config SYS_CPU
	default "p8700"

config BOARD_SPECIFIC_OPTIONS
    def_bool y
    select P8700_RISCV
    imply SYS_NS16550

config SYS_CACHELINE_SIZE
    default 64

config SYS_SDRAM_BASE
    hex
    default 0x80000000

config SYS_INIT_SP_ADDR
    hex
    default 0x80200000

config STANDALONE_LOAD_ADDR
    hex
    default 0x80200000

config SYS_MAX_FLASH_BANKS_DETECT
    bool
    default y

config PHY_REALTEK
    bool
    default y

config TFTP_FILE_NAME_MAX_LEN
    int "Maximum length of TFTP file name"
    default 256

config CMD_DISPLAY
	bool "Enable display command"
	default y

endif
```

## board/wave/boston-riscv/Kconfig
```kconfig
if TARGET_WAVE_BOSTON

config SYS_BOARD
	default "boston-riscv"

config SYS_VENDOR
	default "wave"

config SYS_CONFIG_NAME
	default "boston-riscv"

config SYS_CPU
	default "shogun"

config SYS_TEXT_BASE
	default 0x1fc00000

config BOARD_SPECIFIC_OPTIONS # dummy
	def_bool y
	select SHOGUN_RISCV
	imply SYS_NS16550

config SYS_CACHELINE_SIZE
	default 64

endif
```

## configs/boston-riscv_defconfig
```kconfig
CONFIG_RISCV=y
CONFIG_SYS_TEXT_BASE=0x1fc00000
CONFIG_ENV_SIZE=0x20000
CONFIG_ENV_SECT_SIZE=0x20000
CONFIG_TARGET_WAVE_BOSTON=y
CONFIG_DEFAULT_DEVICE_TREE="wave,boston-riscv"

CONFIG_DISTRO_DEFAULTS=y
CONFIG_FIT=y
CONFIG_FIT_VERBOSE=y
CONFIG_FIT_BEST_MATCH=y
CONFIG_OF_STDOUT_VIA_ALIAS=y
CONFIG_SYS_PROMPT="boston # "
CONFIG_CMD_GREPENV=y
CONFIG_CMD_MEMTEST=y
CONFIG_SYS_MEMTEST_START=0x80000000
CONFIG_SYS_MEMTEST_END=0x90000000
CONFIG_BOOTDELAY=-1

CONFIG_NR_DRAM_BANKS=1
CONFIG_ARCH_RV64I=y
CONFIG_DISPLAY_CPUINFO=y
CONFIG_DISPLAY_BOARDINFO=y
#CONFIG_CMD_BOOTEFI_SELFTEST=y
#CONFIG_CMD_NVEDIT_EFI=y
# CONFIG_CMD_MII is not set
# CONFIG_OF_PRIOR_STAGE=y
CONFIG_SYS_RELOC_GD_ENV_ADDR=y
CONFIG_DM_MTD=y
CONFIG_SMP=n
CONFIG_XIP=y
CONFIG_CLK_BOSTON=y
CONFIG_RISCV_ISA_C=n
CONFIG_SHOW_REGS=y
CONFIG_SYS_NS16550=y

CONFIG_CMD_PCI=y
CONFIG_CMD_SNTP=y
CONFIG_CMD_DNS=y
CONFIG_CMD_LINK_LOCAL=y
CONFIG_CMD_TIME=y
CONFIG_CMD_EXT4_WRITE=y
CONFIG_ENV_IS_IN_FLASH=y
CONFIG_ENV_ADDR=0x1ffe0000
CONFIG_NET_RANDOM_ETHADDR=y
CONFIG_MTD=y
CONFIG_MTD_NOR_FLASH=y
CONFIG_FLASH_CFI_DRIVER=y
CONFIG_CFI_FLASH=y
CONFIG_SYS_FLASH_USE_BUFFER_WRITE=y
CONFIG_SYS_FLASH_USE_PROTECTION=y
CONFIG_SYS_FLASH_CFI=y
CONFIG_DM_ETH=y
CONFIG_PCH_GBE=y
CONFIG_PCI=y
CONFIG_DM_PCI=y
CONFIG_PCI_XILINX=y
CONFIG_LZ4=y
CONFIG_CLK=y
CONFIG_EG20T_GPIO=y

CONFIG_MMC=y
CONFIG_HUSH_PARSER=y
CONFIG_CMD_CPU=y
CONFIG_CMD_MMC=y
CONFIG_CMD_DHCP=y
CONFIG_CMD_PING=y
CONFIG_CMD_EXT4=y
CONFIG_CMD_FAT=y
CONFIG_CMD_FS_GENERIC=y
CONFIG_OF_EMBED=y
CONFIG_CPU=y
CONFIG_MMC_SDHCI=y
CONFIG_MMC_PCI=y
CONFIG_DM_PCI_BRIDGE_MEM_ALIGN=0x0

CONFIG_UNIT_TEST=y
CONFIG_UT_LIB=n
CONFIG_UT_LIB_ASN1=n
CONFIG_UT_LOG=n
CONFIG_UT_TIME=y
CONFIG_UT_UNICODE=n
CONFIG_UT_ENV=n
CONFIG_UT_OVERLAY=n
```
